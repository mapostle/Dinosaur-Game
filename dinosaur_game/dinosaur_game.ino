#include <LiquidCrystal.h>
#include <TimerOne.h>
LiquidCrystal LCD(10,9,5,4,3,2);
int score = 0;
int jumpButton = 13;
int startButton = 12;
int jumpNew = 0;
int jumpOld = 0;
int startNew = 0;
int startOld = 0;
boolean gameOver = false;
int cactus1 = 14;
int cactus2 = 15;
int cactus3 = 15;

byte cactus[] = {
  B00100,
  B00101,
  B10101,
  B10111,
  B11110,
  B01100,
  B00100,
  B00100
};

byte dinosaur[] = {
  B00000,
  B00000,
  B00110,
  B00111,
  B10100,
  B10110,
  B01100,
  B00110
};

void setup() {
  // put your setup code here, to run once:
  pinMode(jumpButton, INPUT);
  pinMode(startButton, INPUT);
  Serial.begin(115200);
  
  LCD.begin(16, 2);
  LCD.createChar(2, cactus);
  LCD.createChar(1, dinosaur);
  LCD.home();
  LCD.print("Welcome to the");
  LCD.setCursor(0, 1);
  LCD.print("Dinosaur Game!");

}

void loop() {
  // put your main code here, to run repeatedly:
  startNew = digitalRead(startButton);
  
  //Game start
  if(startNew == 1 && startOld == 0){
    LCD.clear(); 
    
    //Loop until game is over
    while(gameOver == false){
      
      Timer1.initialize(500000);
      Timer1.attachInterrupt(moveCactus); 
      LCD.setCursor(1, 1);
      LCD.write(1);                       //Spawn dino

      LCD.setCursor(8, 0);
      LCD.print("Score:");
      LCD.print(score);                   //Update score
      
      //Jump
      jumpNew = digitalRead(jumpButton);
      if(jumpNew == 1 && jumpOld == 0){
        LCD.setCursor(1, 1);            
        LCD.print(" ");                 //Remove dino from ground
        
        LCD.home();
        LCD.print(" ");
        LCD.write(1);                   //Place dino in air
        delay(1250);                    //Jump delay
        
        LCD.home();
        LCD.print("                ");  //Clear sky
        LCD.setCursor(1, 1);
        LCD.write(1);                   //Return to ground

        //Increment score
        if(cactus1 <= 0){
          score++;
        }
      }
      //Exit condition
      if(cactus1 == 1 && jumpNew != 1){
        gameOver = true;
        LCD.clear();
        Timer1.stop();
      }
      jumpOld = jumpNew;
      delay(100);                       //Jump cooldown 
    } 
    LCD.home();         
    LCD.print("Game over!");
    LCD.setCursor(0, 1);
    LCD.print("Score:");                //Game over message
    LCD.print(score);
    gameOver = false;
    cactus1 = 14;                       
    score = 0;                          //Reset variables
  }
  startOld = startNew;
}

void moveCactus(){
  //Reset cactus position
  if(cactus1 == -1){
    LCD.setCursor(0, 1);
    LCD.print(" ");
    cactus1 = 14;
  }
  LCD.setCursor(cactus1+1, 1);
  LCD.print(" ");           //Remove previous cactus
    
  LCD.setCursor(cactus1, 1);  
  LCD.write(2);             //Place new cactus
  LCD.print(" ");
  
  cactus1--;
  
}
